## configs/odroid-h4.defconfig
```kconfig
CONFIG_VENDOR_HARDKERNEL=y
CONFIG_IFD_BIN_PATH="site-local/flashregion_0_flashdescriptor.bin"
CONFIG_ME_BIN_PATH="site-local/flashregion_2_intel_me.bin"
CONFIG_HAVE_IFD_BIN=y
CONFIG_HAVE_ME_BIN=y
CONFIG_PAYLOAD_NONE=y
```
